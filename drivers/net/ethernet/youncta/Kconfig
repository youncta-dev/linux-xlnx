## drivers/net/ethernet/youncta/Kconfig
```kconfig
#
# Xilink device configuration
#

config NET_VENDOR_YOUNCTA
	bool "YOUNCTA devices"
	default y
	depends on ARCH_ZYNQ || ARCH_ZYNQMP
	---help---
	  If you have a network (Ethernet) card belonging to this class, say Y
	  and read the Ethernet-HOWTO, available from
	  <http://www.tldp.org/docs.html#howto>.

	  Note that the answer to this question doesn't directly affect the
	  kernel: saying N will just cause the configurator to skip all
	  the questions about YOUNCTA devices. If you say Y, you will be asked
	  for your specific card in the following questions.

if NET_VENDOR_YOUNCTA

config YOUNCTA_EMACLITE
	tristate "YOUNCTA 10/100 Ethernet Lite support"
	depends on (PPC32 || MICROBLAZE || ARCH_ZYNQ || ARCH_ZYNQMP )
	select PHYLIB
	---help---
	  This driver supports the 10/100 Ethernet Lite from YOUNCTA.


config YOUNCTA_TEMAC_SUPPORT
	tristate "YOUNCTA TEMAC support drive"
	depends on (PPC32 || MICROBLAZE || ARCH_ZYNQ || ARCH_ZYNQMP )
	select PHYLIB
	---help---
	  This driver supports the 10/100 Ethernet Lite from YOUNCTA.

endif # NET_VENDOR_YOUNCTA
```
